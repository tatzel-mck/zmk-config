## boards/shields/totem_handwired/Kconfig.defconfig
```kconfig
config ZMK_KEYBOARD_NAME
    default "ToteMCK"

config ZMK_PM
    default y

config ZMK_SPLIT
    default y

config ZMK_SPLIT_BLE
    default y

config BT_PRIVACY
    default n

if SHIELD_TOTEM_HANDWIRED_LEFT

config ZMK_SPLIT_ROLE_CENTRAL
    default y

endif # SHIELD_TOTEM_HANDWIRED_LEFT

if SHIELD_TOTEM_HANDWIRED_LEFT || SHIELD_TOTEM_HANDWIRED_RIGHT

config ZMK_SLEEP
    default y

config ZMK_BATTERY_REPORTING
    default y

endif
```

## boards/shields/totem_handwired/Kconfig.shield
```kconfig
config SHIELD_TOTEM_HANDWIRED_LEFT
    def_bool $(shields_list_contains,totem_handwired_left)

config SHIELD_TOTEM_HANDWIRED_RIGHT
    def_bool $(shields_list_contains,totem_handwired_right)
```
